## drivers/misc/vdsm/Kconfig
```kconfig
# SPDX-License-Identifier: GPL-2.0-only
menu "vDSM Kernel Stub"

config VDSM_KERNEL_STUB
	bool "vDSM Kernel Stub"
	depends on PCI
	select PCI_TDISP
	default y
	help
	  vDSM Kernel Stub for kernel drivers to communicate with the user
	  space SPDM responder emulator.

source "drivers/misc/vdsm/dummy_requester/Kconfig"
endmenu
```

## drivers/misc/vdsm/dummy_requester/Kconfig
```kconfig
# SPDX-License-Identifier: GPL-2.0-only
menu "vDSM Dummy Requester"

config VDSM_DUMMY_REQUESTER
	tristate "vDSM Dummy Requester"
	depends on VDSM_KERNEL_STUB
	default m
	help
	  vDSM dummy requester for vDSM flow testing.

endmenu
```

## drivers/platform/x86/intel/pnp_excursion_monitor/Kconfig
```kconfig
# SPDX-License-Identifier: GPL-2.0-only
#
# PnP excursion monitor
#

menu "Intel PnP excursion monitor"
	depends on X86_64 || INTEL_TPMI || COMPILE_TEST

config INTEL_TPMI_PEM
	tristate "Intel TPMI PEM"
	depends on INTEL_TPMI
	depends on INTEL_PMT_TELEMETRY
	depends on PERF_EVENTS
	help
	  The Intel TPMI PEM (Power and Performance Excursion Monitor)
	  feature provides a configurable interface to get events for
	  power excursion.

	  To compile this driver as a module, choose M here: the module
	  will be called intel_tpmi_pem.

endmenu
```

## drivers/vfio/device/Kconfig
```kconfig
config VFIO_DEVICE_IDXD
	tristate "VFIO device driver for Intel IDXD"
	depends on VFIO && X86_64
	default n
	help
	  VFIO based device driver for Intel Accelerator Devices driver.

config VFIO_DEVICE_INET
	tristate "VFIO device driver for Intel(R) network devices"
	depends on VFIO
	default n
	help
	  VFIO based device driver for Intel(R) network devices
```

## kernel/Kconfig.svos
```kconfig
config SVOS
	bool "Enable SVOS kernel modifications"
	default n
	help
		Enable Intel internal-only SVOS kernel modifications for silicon validation

config SVFS_ACPI
	depends on SVOS && ACPI
	bool "Enable SVOS SVFS ACPI driver support"
	default n
	help
		Enable SVOS ACPI driver support for ACPI debug support
```
